## sw/jtag-switch/boards/renode/frdm_k64f_virtual/Kconfig.defconfig
```kconfig
# FRDM-K64F Virtual Board (Renode)
# SPDX-License-Identifier: Apache-2.0

if BOARD_FRDM_K64F_VIRTUAL

# Oscillator and clock configuration (same as real FRDM-K64F)
config OSC_XTAL0_FREQ
	default 50000000

config MCG_PRDIV0
	default 0x13

config MCG_VDIV0
	default 0x18

config MCG_FCRDIV
	default 1

if NETWORKING

config NET_L2_ETHERNET
	default y if !MODEM

endif # NETWORKING

endif # BOARD_FRDM_K64F_VIRTUAL
```

## sw/jtag-switch/boards/renode/frdm_k64f_virtual/Kconfig.frdm_k64f_virtual
```kconfig
# SPDX-License-Identifier: Apache-2.0

config BOARD_FRDM_K64F_VIRTUAL
	select SOC_MK64F12
	select SOC_PART_NUMBER_MK64FN1M0VLL12
```

## sw/jtag-switch/boards/renode/frdm_k64f_virtual/board.yml
```yaml
board:
  name: frdm_k64f_virtual
  full_name: FRDM-K64F Virtual (Renode)
  vendor: renode
  socs:
    - name: mk64f12
```

## sw/jtag-switch/boards/renode/frdm_k64f_virtual/frdm_k64f_virtual_defconfig
```kconfig
# SPDX-License-Identifier: Apache-2.0

# Serial console (UART0 instead of USB CDC ACM)
CONFIG_CONSOLE=y
CONFIG_UART_CONSOLE=y
CONFIG_SERIAL=y

# GPIO via emulator
CONFIG_GPIO=y
CONFIG_GPIO_EMUL=y

# System clock (match K64F)
CONFIG_SYS_CLOCK_HW_CYCLES_PER_SEC=120000000

# Oscillator (match real hardware for driver compatibility)
CONFIG_OSC_EXTERNAL=y

# Enable ARM MPU
CONFIG_ARM_MPU=y
```

## sw/west.yml
```yaml
manifest:
  remotes:
    - name: zephyrproject-rtos
      url-base: https://github.com/zephyrproject-rtos

  projects:
    - name: zephyr
      remote: zephyrproject-rtos
      revision: v4.3.0    # Pin to a specific version
      import: true        # Import Zephyr's west.yml for HALs, etc.

  self:
    path: jtag_switch
```
